// SPDX-License-Identifier: (GPL-2.0+ OR MIT)
/*
 * Copyright (c) 2025 picocom Ltd.
 *
 */

#include "rk3399-u-boot.dtsi"

/{
	chosen {
		u-boot,spl-boot-order = "same-as-spl", &sdhci, &sdmmc;
	};
};

&sdmmc {
	pinctrl-0 = <&sdmmc_bus4 &sdmmc_clk &sdmmc_cmd &sdmmc_cd>;
};
