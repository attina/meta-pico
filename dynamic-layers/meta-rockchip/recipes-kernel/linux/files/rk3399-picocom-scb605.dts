// SPDX-License-Identifier: (GPL-2.0+ OR MIT)
/*
 * Copyright (c) 2025 picocom Ltd.
 *
 */

/dts-v1/;
#include "rk3399-picocom.dtsi"

/ {
	model = "Picocom SCB 605";
	compatible = "picocom,scb-605", "rockchip,rk3399";
};

&gmac {
	phy-supply = <&vcc3v3_sys>;
	phy-mode = "rgmii";
	phy-handle = <&yt8521s>;
	clock_in_out = "input";
	assigned-clocks = <&cru SCLK_RMII_SRC>;
	assigned-clock-parents = <&clkin_gmac>;
	pinctrl-names = "default", "int", "reset";
	pinctrl-0 = <&rgmii_pins>, <&phy_intb>, <&phy_rstb>;
	snps,reset-gpio = <&gpio3 RK_PB7 GPIO_ACTIVE_LOW>;
	snps,reset-active-low;
	snps,reset-delays-us = <0 10000 50000>;
	tx_delay = <0x22>;
	rx_delay = <0x12>;
	status = "okay";

	mdio {
		compatible = "snps,dwmac-mdio";
		#address-cells = <1>;
		#size-cells = <0>;

		yt8521s: ethernet-phy@3 {
			compatible = "ethernet-phy-ieee802.3-c22";
			reg = <3>;

			motorcomm,clk-out-frequency-hz = <125000000>;
			motorcomm,keep-pll-enabled;
			motorcomm,auto-sleep-disabled;

			interrupt-parent = <&gpio1>;
			interrupts = <RK_PC4 IRQ_TYPE_LEVEL_LOW>;
		};
	};
};
