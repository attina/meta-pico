## conf/distro/pico.conf
```bitbake
require conf/distro/poky.conf

DISTRO = "pico"
DISTRO_NAME = "Picocom SDK"
MAINTAINER = "Gavin Gao <attinagaoxu@gmail.com>"

TARGET_VENDOR = "-pico"

SDK_VENDOR = "-picosdk"
SDK_NAME_PREFIX = "${DISTRO}"

POKY_DEFAULT_DISTRO_FEATURES:remove = " ptest"
DISTRO_FEATURES:append = "  ipv6 security"

SOC_DEFAULT_IMAGE_FSTYPES:append = " cpio.gz"
```

## conf/layer.conf
```bitbake
# We have a conf and classes directory, add to BBPATH
BBPATH .= ":${LAYERDIR}"

# We have recipes-* directories, add to BBFILES
BBFILES += "${LAYERDIR}/recipes-*/*/*.bb \
            ${LAYERDIR}/recipes-*/*/*.bbappend"

BBFILES_DYNAMIC += " \
    meta-qoriq:${LAYERDIR}/dynamic-layers/meta-qoriq/*/*/*.bb \
    meta-qoriq:${LAYERDIR}/dynamic-layers/meta-qoriq/*/*/*.bbappend \
    rockchip:${LAYERDIR}/dynamic-layers/meta-rockchip/*/*/*.bb \
    rockchip:${LAYERDIR}/dynamic-layers/meta-rockchip/*/*/*.bbappend \
"

BBFILE_COLLECTIONS += "meta-pico"
BBFILE_PATTERN_meta-pico = "^${LAYERDIR}/"
BBFILE_PRIORITY_meta-pico = "10"

LAYERDEPENDS_meta-pico = "core"
LAYERSERIES_COMPAT_meta-pico = "kirkstone nanbield"
```

## conf/machine/include/rk3576.inc
```bitbake
SOC_FAMILY = "rk3576"

DEFAULTTUNE ?= "cortexa72-cortexa53-crypto"

ROCKCHIP_CLOSED_TPL ?= "1"

require conf/machine/include/soc-family.inc
require conf/machine/include/rockchip-defaults.inc
require conf/machine/include/arm/armv8a/tune-cortexa72-cortexa53.inc
require conf/machine/include/rockchip-wic.inc

KBUILD_DEFCONFIG ?= "defconfig"
KERNEL_FEATURES:append:rk3568 = " bsp/rockchip/remove-non-rockchip-arch-arm64.scc"

MACHINE_EXTRA_RRECOMMENDS += "kernel-modules"
KERNEL_CLASSES += "kernel-fit-extra-artifacts"
KERNEL_IMAGETYPE = "Image.gz"

PREFERRED_PROVIDER_trusted-firmware-a = "rockchip-rkbin-tf-a"
PREFERRED_PROVIDER_optee-os = "rockchip-rkbin-optee-os"

UBOOT_SUFFIX ?= "img"
UBOOT_ENTRYPOINT ?= "0x40200000"
UBOOT_MACHINE ?= "rk3576_defconfig"

TFA_PLATFORM = "rk3576"
TFA_BUILD_TARGET = "bl31"

ENABLE_STATELESS_VPU_GST ?= "1"

SERIAL_CONSOLES = "1500000;ttyS0"
```

## conf/machine/ls1046apscb.conf
```bitbake
#@TYPE: Machine
#@NAME: PICOCOM LS1046APSCB
#@SOC: LSCH2
#@DESCRIPTION: Machine configuration for running LS1046A in 64-bit mode
#@MAINTAINER: Gavin Gao <attinagaoxu@gmail.com>

MACHINEOVERRIDES =. "fsl-lsch2:ls1046a:"

require conf/machine/include/qoriq-arm64.inc
require conf/machine/include/arm/arch-arm64.inc

MACHINE_FEATURES += "optee"

KERNEL_CLASSES  = " kernel-fitimage "
KERNEL_IMAGETYPES = "fitImage"

UBOOT_DTB_LOADADDRESS = "0x90000000"
UBOOT_ENTRYPOINT = "0x80080000"

UBOOT_CONFIG ??= "tfa-secure-boot tfa"
UBOOT_CONFIG[tfa] = "ls1046apscb_tfa_defconfig"
UBOOT_CONFIG[tfa-secure-boot] = "ls1046apscb_tfa_SECURE_BOOT_defconfig"

KERNEL_DEVICETREE ?= "\
    freescale/fsl-ls1046a-pscb-sdk.dtb \
"
# usdpaa dtb is used for dpdk. TODO: rename in kernel
KERNEL_DEVICETREE:prepend:use-nxp-bsp = "\
    freescale/fsl-ls1046a-rdb-sdk.dtb \
    freescale/fsl-ls1046a-rdb-usdpaa.dtb \
    freescale/fsl-ls1046a-rdb-usdpaa-shared.dtb \
    freescale/fsl-ls1046a-qds-sdk.dtb \
"
KERNEL_DEFCONFIG ?= "defconfig picoscb.config"

SERIAL_CONSOLES ?= "115200;ttyS0 115200;ttyAMA0 115200;ttyLP0"
SERIAL_CONSOLES_CHECK ?= "${SERIAL_CONSOLES}"

UEFI_QSPIBOOT ?= "LS1046ARDB_EFI_QSPIBOOT.fd"
RCWQSPI ?= "NN_FNSNPPPP_1133_8888/rcw_1600_qspiboot"
RCWSD ?= "NN_FNSNPPPP_1133_8888/rcw_1600_sdboot"

FMAN_UCODE ?= "fsl_fman_ucode_ls1046_r1.0_106_4_18.bin"

EXTRA_IMAGEDEPENDS += "fm-ucode rcw uefi qoriq-atf qe-ucode ls2-phy"
USE_VT = "0"
```

## conf/machine/ls1046apscbc.conf
```bitbake
#@TYPE: Machine
#@NAME: PICOCOM LS1046APSCBC
#@SOC: LSCH2
#@DESCRIPTION: Machine configuration for running LS1046A in 64-bit mode
#@MAINTAINER: Gavin Gao <attinagaoxu@gmail.com>

MACHINEOVERRIDES =. "fsl-lsch2:ls1046a:"

require conf/machine/include/qoriq-arm64.inc
require conf/machine/include/arm/arch-arm64.inc

MACHINE_FEATURES += "optee"

KERNEL_CLASSES  = " kernel-fitimage "
KERNEL_IMAGETYPES = "fitImage"

UBOOT_DTB_LOADADDRESS = "0x90000000"
UBOOT_ENTRYPOINT = "0x80080000"

UBOOT_CONFIG ??= "tfa-secure-boot tfa"
UBOOT_CONFIG[tfa] = "ls1046apscbc_tfa_defconfig"
UBOOT_CONFIG[tfa-secure-boot] = "ls1046apscbc_tfa_SECURE_BOOT_defconfig"

KERNEL_DEVICETREE ?= "\
    freescale/fsl-ls1046a-pscbc.dtb \
"
# usdpaa dtb is used for dpdk. TODO: rename in kernel
KERNEL_DEVICETREE:prepend:use-nxp-bsp = "\
    freescale/fsl-ls1046a-pscbc-sdk.dtb \
    freescale/fsl-ls1046a-pscbc-usdpaa.dtb \
"
KERNEL_DEFCONFIG ?= "defconfig"

SERIAL_CONSOLES:qoriq-arm64 = "115200;ttyS0 115200;ttyAMA0 115200;ttyLP0"
SERIAL_CONSOLES_CHECK ?= "${SERIAL_CONSOLES}"

UEFI_QSPIBOOT ?= "LS1046ARDB_EFI_QSPIBOOT.fd"
RCWQSPI ?= "NN_FNSNPPPP_3333_8888/rcw_1600_qspiboot"
RCWSD ?= "NN_FNSNPPPP_3333_8888/rcw_1600_sdboot"
RCWEMMC ?= "NN_FNSNPPPP_3333_8888/rcw_1600_emmcboot"

FMAN_UCODE ?= "fsl_fman_ucode_ls1046_r1.0_106_4_18.bin"

EXTRA_IMAGEDEPENDS += "fm-ucode rcw uefi qoriq-atf qe-ucode ls2-phy"
USE_VT = "0"
```

## conf/machine/ls1046apscbx5.conf
```bitbake
#@TYPE: Machine
#@NAME: PICOCOM LS1046APSCBX5
#@SOC: LSCH2
#@DESCRIPTION: Machine configuration for running LS1046A in 64-bit mode
#@MAINTAINER: Gavin Gao <attinagaoxu@gmail.com>

MACHINEOVERRIDES =. "fsl-lsch2:ls1046a:"

require conf/machine/include/qoriq-arm64.inc
require conf/machine/include/arm/arch-arm64.inc

MACHINE_FEATURES += "optee"

KERNEL_CLASSES  = " kernel-fitimage "
KERNEL_IMAGETYPES = "fitImage"

UBOOT_DTB_LOADADDRESS = "0x90000000"
UBOOT_ENTRYPOINT = "0x80080000"

UBOOT_CONFIG ??= "tfa-secure-boot tfa"
UBOOT_CONFIG[tfa] = "ls1046apscbx5_tfa_defconfig"
UBOOT_CONFIG[tfa-secure-boot] = "ls1046apscbx5_tfa_SECURE_BOOT_defconfig"

KERNEL_DEVICETREE ?= "\
    freescale/fsl-ls1046a-pscbx5.dtb \
"
# usdpaa dtb is used for dpdk. TODO: rename in kernel
KERNEL_DEVICETREE:prepend:use-nxp-bsp = "\
    freescale/fsl-ls1046a-pscbx5-sdk.dtb \
    freescale/fsl-ls1046a-pscbx5-usdpaa.dtb \
"
KERNEL_DEFCONFIG ?= "defconfig"

SERIAL_CONSOLES:qoriq-arm64 = "115200;ttyS0 115200;ttyAMA0 115200;ttyLP0"
SERIAL_CONSOLES_CHECK ?= "${SERIAL_CONSOLES}"

UEFI_QSPIBOOT ?= "LS1046ARDB_EFI_QSPIBOOT.fd"
RCWQSPI ?= "NN_FNSNPPPP_1133_8888/rcw_1600_qspiboot"
RCWSD ?= "NN_FNSNPPPP_1133_8888/rcw_1600_sdboot"
RCWEMMC ?= "NN_FNSNPPPP_1133_8888/rcw_1600_emmcboot"

FMAN_UCODE ?= "fsl_fman_ucode_ls1046_r1.0_106_4_18.bin"

EXTRA_IMAGEDEPENDS += "fm-ucode rcw uefi qoriq-atf qe-ucode ls2-phy"
USE_VT = "0"
```

## conf/machine/ok3576.conf
```bitbake
# Copyright (c) 2025, Picocom Co., Ltd
# Released under the MIT license (see COPYING.MIT for the terms)

#@TYPE: Machine
#@NAME: Forlinx OK3576
#@MAINTAINER: <attinagaoxu@gmail.com> Gavin Gao
#@DESCRIPTION: OK3576 is a high-end Picocom mini-router based on the RK3576 SoC

require conf/machine/include/rk3576.inc

KERNEL_DEVICETREE = "rockchip/OK3576-C-linux.dtb"

MACHINE_FEATURES += "rk-u-boot-env"

PREFERRED_PROVIDER_virtual/kernel = "linux-rockchip"
PREFERRED_VERSION_linux-rockchip = "6.1%"
```

## conf/machine/scb600.conf
```bitbake
# Copyright (c) 2019, Picocom Co., Ltd
# Released under the MIT license (see COPYING.MIT for the terms)

#@TYPE: Machine
#@NAME: Picocom SCB600
#@MAINTAINER: <attinagaoxu@gmail.com> Gavin Gao
#@DESCRIPTION: SCB600 is a high-end Picocom mini-router based on the RK3399 SoC

require conf/machine/include/rk3399.inc

KERNEL_DEVICETREE = "rockchip/rk3399-picocom-scb600.dtb"

UBOOT_MACHINE = "nanopi-r4s-rk3399_defconfig"

RK_WIFIBT_RRECOMMENDS = " \
	rkwifibt-firmware-ap6354-wifi \
	rkwifibt-firmware-ap6354-bt \
	brcm-tools \
"
```

## conf/machine/scb605.conf
```bitbake
# Copyright (c) 2019, Picocom Co., Ltd
# Released under the MIT license (see COPYING.MIT for the terms)

#@TYPE: Machine
#@NAME: Picocom SCB605
#@MAINTAINER: <attinagaoxu@gmail.com> Gavin Gao
#@DESCRIPTION: SCB605 is a high-end Picocom mini-router based on the RK3399 SoC

require conf/machine/include/rk3399.inc

# Install all the kernel modules into the rootfs
MACHINE_EXTRA_RRECOMMENDS += "kernel-modules"
# Install selected pieces of firmware
MACHINE_EXTRA_RRECOMMENDS += "linux-firmware-rtl-nic"

KERNEL_DEVICETREE = "rockchip/rk3399-picocom-scb605.dtb"
UBOOT_MACHINE = "picocom-scb605_defconfig"
```

## dynamic-layers/meta-qoriq/recipes-fsl/images/fsl-image-kernelitb/kernel-arm64-pico.its
```
/*
 * Copyright 2017 NXP
 *
 */


/dts-v1/;

/ {
	description = "arm64 kernel, ramdisk and FDT blob";
	#address-cells = <1>;

	images {
		kernel {
			description = "ARM64 Kernel";
			data = /incbin/("kernel-image.gz");
			type = "kernel";
			arch = "arm64";
			os = "linux";
			compression = "gzip";
			load = <0x84080000>;
			entry = <0x84080000>;
			hash-1 {
				algo = "crc32";
			};
		};

		initrd {
			description = "initrd for arm64";
			data = /incbin/("rootfs.cpio.gz");
			type = "ramdisk";
			arch = "arm64";
			os = "linux";
			compression = "none";
			load = <0x00000000>;
			entry = <0x00000000>;
			hash-1 {
				algo = "crc32";
			};
		};

		fdt-dtb {
			description = "nxp-dtb";
			data = /incbin/("freescale.dtb");
			type = "flat_dt";
			arch = "arm64";
			os = "linux";
			compression = "none";
			load = <0x90000000>;
			hash-1 {
				algo = "crc32";
			};
		};
	};

	configurations {
		ls1046apscb {
			description = "config for ls1046apscb";
			kernel = "kernel";
			ramdisk = "initrd";
			fdt = "fdt-dtb";
		};

		ls1046apscbc {
			description = "config for ls1046apscbc";
			kernel = "kernel";
			ramdisk = "initrd";
			fdt = "fdt-dtb";
		};

		ls1046apxcp {
			description = "config for ls1046apxcp";
			kernel = "kernel";
			ramdisk = "initrd";
			fdt = "fdt-dtb";
		};

		ls1046apscbx5 {
			description = "config for ls1046apscbx5";
			kernel = "kernel";
			ramdisk = "initrd";
			fdt = "fdt-dtb";
		};
	};
};
```
